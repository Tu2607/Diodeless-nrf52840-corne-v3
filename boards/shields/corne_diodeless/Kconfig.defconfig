## boards/shields/corne_diodeless/Kconfig.defconfig
```kconfig
# SPDX-License-Identifier: MIT

if SHIELD_CORNE_DIODELESS_LEFT

config ZMK_KEYBOARD_NAME
    default "Corne DL"

config ZMK_SPLIT_ROLE_CENTRAL
    default y

endif

if SHIELD_CORNE_DIODELESS_LEFT || SHIELD_CORNE_DIODELESS_RIGHT

config ZMK_SPLIT
    default y

endif
```

## boards/shields/corne_diodeless/Kconfig.shield
```kconfig
# SPDX-License-Identifier: MIT

config SHIELD_CORNE_DIODELESS_LEFT
    def_bool $(shields_list_contains,corne_diodeless_left)

config SHIELD_CORNE_DIODELESS_RIGHT
    def_bool $(shields_list_contains,corne_diodeless_right)
```
